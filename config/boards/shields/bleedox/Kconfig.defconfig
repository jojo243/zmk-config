## config/boards/shields/bleedox/Kconfig.defconfig
```kconfig
if SHIELD_BLEEDOX_LEFT

config ZMK_KEYBOARD_NAME
	default "Bleedox"

config ZMK_SPLIT_ROLE_CENTRAL
	default y

endif

if SHIELD_BLEEDOX_LEFT || SHIELD_BLEEDOX_RIGHT

config ZMK_SPLIT
	default y

endif
```

## config/boards/shields/bleedox/Kconfig.shield
```kconfig
config SHIELD_BLEEDOX_LEFT
	def_bool $(shields_list_contains,bleedox_left)

config SHIELD_BLEEDOX_RIGHT
	def_bool $(shields_list_contains,bleedox_right)
```

## config/west.yml
```yaml
manifest:
  remotes:
    - name: zmkfirmware
      url-base: https://github.com/zmkfirmware
  projects:
    - name: zmk
      remote: zmkfirmware
      revision: main
      import: config/west.yml
  self:
    path: config
```
